## config/west.yml
```yaml
manifest:
    remotes:
        - name: zmkfirmware
          url-base: https://github.com/zmkfirmware
        - name: hf02
          url-base: https://github.com/hf02
        # Additional modules containing boards/shields/custom code can be listed here as well
        # See https://docs.zephyrproject.org/3.2.0/develop/west/manifest.html#projects
    projects:
        - name: zmk
          remote: zmkfirmware
          revision: 4ec69cb7e658590adf6354027aca789b364a70c5
          import: app/west.yml
        - name: nice-view-gem #new entry
          remote: hf02 #new entry
          revision: main #new entry
        - name: nice-view-turtle #new entry
          remote: hf02 #new entry
          revision: 159c4c1ac4867c491b05ccc0403fc0e9c578e7a8 #new entry
    self:
        path: config
```
